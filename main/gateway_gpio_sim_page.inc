/* GW_V6_3_GPIO_SIM: fixed pin map, logical simulation only */
static esp_err_t gw_map_page(httpd_req_t *req)
{
    if (!http_server_request_authenticated(req)) {
        httpd_resp_set_status(req,"303 See Other");
        httpd_resp_set_hdr(req,"Location","/?auth_required=1");
        return httpd_resp_send(req,NULL,0);
    }
    send_page_start(req,"GPIO / Palabras / Simulador","map");
    httpd_resp_sendstr_chunk(req,"<div class=\"card gwpanel\">\n<h2>GPIO / PALABRAS / SIMULADOR \u2014 WT32-ETH01</h2>\n<p class=\"sub\">Mapa fisico fijo. Los selectores describen la funcion logica; no remapean pines. SIMULAR no conmuta salidas fisicas.</p>\n<div class=\"gwstatus\" id=\"gwSummary\">Cargando configuracion...</div>\n<div class=\"gw-layout\">\n <div class=\"gw-side\" id=\"gwLeft\"></div>\n <div class=\"gw-board\"><div class=\"gw-ant\">ANTENA</div><div class=\"gw-chip\">ESP32<br><small>WT32-ETH01<");
    httpd_resp_sendstr_chunk(req,"/small></div><div class=\"gw-net\">LAN8720<br><small>ETHERNET</small></div><div class=\"gw-rj\">RJ45</div></div>\n <div class=\"gw-side\" id=\"gwRight\"></div>\n</div>\n<div class=\"gwactions\"><button id=\"gwSave\">GUARDAR MAPA GPIO</button><button class=\"ghost\" id=\"gwReload\">RECARGAR</button><span id=\"gwResult\" class=\"sub\"></span></div>\n<div class=\"gwtest\"><strong>Simular lectura Wiegand (D0 + D1)</strong><label>Formato <select id=\"gwFormat\"><option value=\"26");
    httpd_resp_sendstr_chunk(req,"\">26 bits</option><option value=\"34\">34 bits</option></select></label><label>Facility <input type=\"number\" min=\"0\" max=\"65535\" id=\"gwFacility\" value=\"101\"></label><label>Tarjeta <input type=\"number\" min=\"0\" max=\"65535\" id=\"gwCard\" value=\"38724\"></label><button class=\"ghost\" id=\"gwCardBtn\">SIMULAR TARJETA</button></div>\n<p class=\"sub\">Los pulsos Wiegand RX se simulan como una tarjeta completa. Los GPIO 5/17 TX solo emiten evento simulado; no hay p");
    httpd_resp_sendstr_chunk(req,"ulsos electricos. Los estados de puerta, REX, llamada, rele y baliza son eventos simulados, no estados de campo.</p>\n</div>\n<style>\n.gwpanel{max-width:1220px}.gwstatus{padding:11px;border:1px solid #544526;border-radius:8px;margin:12px 0;color:#ffc857}.gw-layout{display:grid;grid-template-columns:minmax(0,1fr) 230px minmax(0,1fr);gap:10px;align-items:stretch}.gw-side{display:flex;flex-direction:column;gap:7px;justify-content:center}.gw-pin{min-he");
    httpd_resp_sendstr_chunk(req,"ight:54px;border:1px solid #443921;border-radius:8px;padding:6px 8px;background:#1d1a15}.gw-pin .gw-head{display:flex;justify-content:space-between;gap:8px;align-items:center;font-size:12px}.gw-pin .gw-head b{color:#ffc857}.gw-pin .gw-head small{color:#999}.gw-controls{display:flex;gap:6px;align-items:center;margin-top:4px}.gw-controls select{padding:6px;font-size:12px;min-width:0;flex:1}.gw-controls button{font-size:11px;padding:7px 9px;white-sp");
    httpd_resp_sendstr_chunk(req,"ace:nowrap}.gw-pin.disabled{opacity:.55}.gw-board{background:linear-gradient(155deg,#16452c,#082918);border:4px solid #0d5a35;border-radius:10px;min-height:520px;position:relative;display:flex;align-items:center;flex-direction:column;justify-content:space-around;box-shadow:0 0 0 2px #3a3222 inset}.gw-ant{border:2px solid #cba95c;border-radius:5px;padding:10px 20px;color:#f4c76c;letter-spacing:2px;font-size:11px}.gw-chip{background:#1b1b1b;color:#");
    httpd_resp_sendstr_chunk(req,"ddd;border:2px solid #666;border-radius:8px;padding:38px 17px;text-align:center;font-weight:bold;font-size:23px}.gw-chip small,.gw-net small{font-size:11px}.gw-net{color:#ddd;text-align:center;background:#203c35;border:1px solid #7e9c85;border-radius:6px;padding:12px 18px}.gw-rj{background:#999;color:#111;border-radius:4px 4px 14px 14px;padding:13px 38px;font-weight:bold}.gwactions{display:flex;gap:8px;align-items:center;flex-wrap:wrap;margin-top");
    httpd_resp_sendstr_chunk(req,":14px}.gwtest{display:flex;gap:10px;align-items:end;flex-wrap:wrap;margin:16px 0;padding:12px;background:#1c1a16;border:1px solid #514126;border-radius:8px}.gwtest label{font-size:12px;color:#aaa;max-width:130px}.gwtest input,.gwtest select{margin-top:4px;padding:7px}.gwtest strong{width:100%;color:#ffc857}@media(max-width:850px){.gw-layout{grid-template-columns:1fr}.gw-board{min-height:320px;order:-1}.gw-side{gap:5px}}\n</style>\n<script>\n(()=>{\n ");
    httpd_resp_sendstr_chunk(req,"const $=id=>document.getElementById(id);let rows=[],mapOk=false;\n const groups={left:[5,17,32,33],right:[39,36,14,35,4]};\n const functions={0:'Sin palabra / funcion fisica',16:'DOOR_LOCKED \u00b7 Puerta cerrada',17:'DOOR_OPENED \u00b7 Puerta abierta',18:'REX \u00b7 Solicitud salida',19:'CALL_BUTTON \u00b7 Llamada',32:'DOOR_OPEN \u00b7 Rele apertura'};\n const names={35:'Wiegand D0 RX',36:'Wiegand D1 RX',5:'Wiegand D0 TX',17:'Wiegand D1 TX',4:'REX',32:'Sensor puerta',39:'P");
    httpd_resp_sendstr_chunk(req,"ulsador llamada',33:'Rele apertura',14:'Baliza'};\n const actions={35:'card',36:'card',5:'tx',17:'tx',4:'rex_on',32:'door_open',39:'call_short',33:'sim_relay',14:'sim_beacon_on'};\n function rowHTML(x){let opts='<option value=\"'+x.word+'\">'+(functions[x.word]||'Funcion fisica \u00b7 sin palabra')+'</option>';let sim=actions[x.gpio]||'';let label=names[x.gpio]||x.label;return '<div class=\"gw-pin\" data-gpio=\"'+x.gpio+'\" data-id=\"'+x.id+'\"><div class=\"gw-h");
    httpd_resp_sendstr_chunk(req,"ead\"><b>IO'+x.gpio+'</b><small>'+label+'</small></div><div class=\"gw-controls\"><select title=\"Palabra del diccionario\" disabled>'+opts+'</select><label title=\"Habilitar declaracion logica\"><input type=\"checkbox\" class=\"gwen\" data-id=\"'+x.id+'\" '+(x.enabled?'checked':'')+'></label><button type=\"button\" class=\"ghost gwsim\" data-action=\"'+sim+'\">SIMULAR</button></div></div>'}\n function makeGroup(pins,el){el.innerHTML='';pins.forEach(g=>{let rr=rows.");
    httpd_resp_sendstr_chunk(req,"filter(x=>x.gpio===g);if(!rr.length)return;let x=rr[0];let d=document.createElement('div');d.innerHTML=rowHTML(x);let node=d.firstChild;if(g===32){let second=rr[1];node.querySelector('select').innerHTML='<option>DOOR_LOCKED 0x10 / DOOR_OPENED 0x11</option>';node.querySelector('.gw-controls').insertAdjacentHTML('beforeend','<button type=\"button\" class=\"ghost gwsim\" data-action=\"door_closed\">CERRAR</button>');node.dataset.second=second.id;}if(g===4");
    httpd_resp_sendstr_chunk(req,")node.querySelector('.gw-controls').insertAdjacentHTML('beforeend','<button type=\"button\" class=\"ghost gwsim\" data-action=\"rex_off\">SOLTAR</button>');if(g===14)node.querySelector('.gw-controls').insertAdjacentHTML('beforeend','<button type=\"button\" class=\"ghost gwsim\" data-action=\"sim_beacon_off\">OFF</button>');el.appendChild(node);if(g===32){let extra=document.createElement('label');extra.style.fontSize='11px';extra.innerHTML='<input type=\"check");
    httpd_resp_sendstr_chunk(req,"box\" class=\"gwen\" data-id=\"'+second.id+'\" '+(second.enabled?'checked':'')+'> Habilitar estado PUERTA ABIERTA';node.appendChild(extra);}})}\n async function load(){try{let r=await fetch('/api/gw/map',{cache:'no-store'}),d=await r.json();if(!r.ok||!d.rows)throw Error(d.error||'Error mapa');rows=d.rows;mapOk=!!d.ok;$('gwSummary').textContent='NVS: '+(d.saved?'GUARDADA':'SIN GUARDAR')+'  |  MAPA: '+d.percent+'%  |  '+(d.ok?'GPIO OK':'INCOMPLETO')+'  |");
    httpd_resp_sendstr_chunk(req,"  REVISION '+d.revision+'  |  Diccionario: V1 local (comparacion remota pendiente)';makeGroup(groups.left,$('gwLeft'));makeGroup(groups.right,$('gwRight'));$('gwResult').textContent='';}catch(e){$('gwResult').textContent='Error: '+e.message}}\n async function sim(action){if(!action)return;let p=new URLSearchParams({action});if(action==='wiegand'){p.set('format',$('gwFormat').value);p.set('facility',$('gwFacility').value);p.set('card',$('gwCard').v");
    httpd_resp_sendstr_chunk(req,"alue)}try{let r=await fetch('/api/gw/diag',{method:'POST',headers:{'Content-Type':'application/x-www-form-urlencoded'},body:p}),d=await r.json();$('gwResult').textContent=d.ok?'SIMULADO: '+action+' (sin cambiar GPIO fisicos)':'ERROR: '+(d.error||'sin respuesta')}catch(e){$('gwResult').textContent=e.message}}\n document.querySelector('.gw-layout').addEventListener('click',e=>{let b=e.target.closest('button.gwsim');if(!b)return;let a=b.dataset.actio");
    httpd_resp_sendstr_chunk(req,"n;if(a==='card'){$('gwCardBtn').scrollIntoView({block:'nearest'});$('gwResult').textContent='Ingrese la tarjeta y pulse SIMULAR TARJETA';return}if(a==='tx'){sim('sim_wiegand_tx');return}sim(a)});\n $('gwCardBtn').onclick=()=>sim('wiegand');$('gwReload').onclick=load;\n $('gwSave').onclick=async()=>{let p=new URLSearchParams();rows.forEach(x=>{let cb=document.querySelector('.gwen[data-id=\"'+x.id+'\"]');p.set('en'+x.id,cb&&cb.checked?'1':'0');p.set('w");
    httpd_resp_sendstr_chunk(req,"ord'+x.id,String(x.word))});try{let r=await fetch('/api/gw/map',{method:'POST',headers:{'Content-Type':'application/x-www-form-urlencoded'},body:p}),d=await r.json();if(!d.rows)throw Error(d.error||'Error NVS');await load();$('gwResult').textContent='Mapa guardado en NVS';}catch(e){$('gwResult').textContent='Error: '+e.message}};\n load();\n})();\n</script>\n");
    httpd_resp_sendstr_chunk(req,"</div></body></html>");
    return httpd_resp_sendstr_chunk(req,NULL);
}
