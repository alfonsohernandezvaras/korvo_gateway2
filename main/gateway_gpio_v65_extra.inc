/* GW_V6_5_FUSION_GPIO_SIMULADOR */
    httpd_resp_sendstr_chunk(req,"<section class=\"v65-extras\"><div class=\"v65-card\"><h2>LECTORES WIEGAND - SIMULACION INDEPENDIENTE</h2><p>Lector 1: GPIO35/36 RX. Lector 2: simulacion logica; no dispone de un segundo par RX fisico.</p><div class=\"v65-grid\"><div class=\"v65-reader\"><b>LECTOR 1</b><label>Formato <select id=\"v65fmt1\"><option value=\"26\">26 bits</option><option value=\"34\">34 bits</option></select></label><label>Facility <input id=\"v65fac1\" type=\"number\" min=\"0\" value=\"101\"></label><label>Tarjeta <input id=\"v65card1\" type=\"number\" min=\"0\" value=\"38724\"></label><button type=\"button\" id=\"v65send1\">SIMULAR LECTOR 1</button></div><div class=\"v65-reader\"><b>LECTOR 2 (VIRTUAL)</b><label>Formato <select id=\"v65fmt2\"><option value=\"26\">26 bits</option><option value=\"34\">34 bits</option></select></label><label>Facility <input id=\"v65fac2\" type=\"number\" min=\"0\" value=\"102\"></label><label>Tarjeta <input id=\"v65card2\" type=\"number\" min=\"0\" value=\"38725\"></label><button type=\"button\" id=\"v65send2\">SIMULAR LECTOR 2</button></div></div></div><div class=\"v65-grid\"><div class=\"v65-card\"><h2>SIP / VOIP</h2><label>Estado <sel");
    httpd_resp_sendstr_chunk(req,"ect id=\"v65sipstate\"><option>idle</option><option>ringing</option><option>calling</option><option>active</option><option>busy</option><option>ended</option></select></label><label>Direccion <select id=\"v65sipdir\"><option>incoming</option><option>outgoing</option></select></label><label>Extension <input id=\"v65ext\" value=\"300\"></label><label>Nombre <input id=\"v65name\" value=\"Sala Control\"></label><div class=\"v65-buttons\"><button data-v65=\"sip_state\">ENVIAR ESTADO</button><button data-v65=\"sip_registered\">REGISTRADO</button><button data-v65=\"sip_unregistered\">SIN REGISTRO</button></div></div><div class=\"v65-card\"><h2>BLUETOOTH / AUDIO</h2><label>Dispositivo <input id=\"v65device\" value=\"TEST HEADSET\"></label><div class=\"v65-buttons\"><button data-v65=\"bt_on\">BT CONECTADO</button><button data-v65=\"bt_off\">BT OFF</button><button data-v65=\"audio_ready\">AUDIO READY</button><button data-v65=\"audio_not_ready\">AUDIO OFF</button></div><h2>EMparejamiento / WIFI</h2><div class=\"v65-buttons\"><button data-v65=\"peer_ok\">PAIR OK</button><button data-v65=\"peer_mismatch\">MISMATCH</button><button data-v6");
    httpd_resp_sendstr_chunk(req,"5=\"peer_auth_fail\">AUTH FAIL</button><button data-v65=\"peer_offline\">OFFLINE</button></div><label>RSSI dBm <input id=\"v65rssi\" type=\"number\" value=\"-52\"></label><label>Canal <input id=\"v65channel\" type=\"number\" value=\"6\"></label><div class=\"v65-buttons\"><button data-v65=\"wifi\">SIMULAR WIFI</button><button data-v65=\"wifi_real\">WIFI REAL</button></div></div></div><div class=\"v65-card\"><h2>ESTADO EN VIVO</h2><button type=\"button\" id=\"v65refresh\">ACTUALIZAR ESTADO</button><pre id=\"v65live\">Sin consultar</pre><p>Los eventos se generan localmente; su recepcion por KORVO requiere confirmacion remota.</p></div></section><style>.v65-extras{margin-top:18px}.v65-card{border:1px solid #5a4723;border-radius:9px;padding:14px;margin-bottom:12px;background:#211d17}.v65-card h2{font-size:15px;color:#ffb900;margin:0 0 12px}.v65-card p{color:#aaa;font-size:12px}.v65-grid{display:grid;grid-template-columns:repeat(2,minmax(0,1fr));gap:12px}.v65-reader{border:1px solid #66532c;padding:12px;border-radius:8px;display:flex;flex-direction:column;gap:9px}.v65-reader b{color:#ffbb11}.v65-card label{display:flex");
    httpd_resp_sendstr_chunk(req,";align-items:center;justify-content:space-between;gap:10px;margin:8px 0;font-size:13px}.v65-card input,.v65-card select{background:#17140f;border:1px solid #66532c;border-radius:5px;color:white;padding:8px;max-width:65%;min-width:90px}.v65-buttons{display:flex;gap:7px;flex-wrap:wrap;margin:12px 0}.v65-card button{background:#ffb600;border:0;border-radius:6px;padding:9px 12px;color:#1b1508;font-weight:700;cursor:pointer}.v65-card pre{white-space:pre-wrap;overflow:auto;max-height:240px;font-size:12px;color:#ddd}.gp-bottom>.gp-test:first-child{display:none}@media(max-width:760px){.v65-grid{grid-template-columns:1fr}}</style><script>(function(){'use strict';const $=id=>document.getElementById(id);const log=(msg)=>{const el=$('gpLog');if(!el)return;if(el.textContent==='Sin pruebas realizadas.')el.textContent='';const row=document.createElement('div');row.textContent=new Date().toLocaleTimeString()+' | '+msg;el.prepend(row)};async function post(action,fields={}){const params=new URLSearchParams({action,...fields});try{const r=await fetch('/api/gw/diag',{method:'POST',headers:{'Content-Type");
    httpd_resp_sendstr_chunk(req,"':'application/x-www-form-urlencoded'},body:params});const data=await r.json();if(!r.ok||!data.ok)throw Error(data.error||'Error HTTP '+r.status);log('SIM '+action+' | generado localmente; entrega a KORVO sin confirmar');}catch(e){log('ERROR '+action+': '+e.message)}}for(let reader=1;reader<=2;reader++){$('v65send'+reader).onclick=()=>post('wiegand',{reader:String(reader),format:$('v65fmt'+reader).value,facility:$('v65fac'+reader).value,card:$('v65card'+reader).value})}document.querySelectorAll('[data-v65]').forEach(btn=>btn.onclick=()=>{const a=btn.dataset.v65;const args={};if(a==='sip_state'){args.state=$('v65sipstate').value;args.direction=$('v65sipdir').value;args.extension=$('v65ext').value;args.name=$('v65name').value}else if(a==='bt_on'){args.device=$('v65device').value}else if(a==='wifi'){args.rssi=$('v65rssi').value;args.channel=$('v65channel').value}post(a,args)});$('v65refresh').onclick=async()=>{try{const r=await fetch('/api/gw/status',{cache:'no-store'});const d=await r.json();$('v65live').textContent=JSON.stringify(d,null,2)}catch(e){$('v65live').textContent='ERROR '+e.");
    httpd_resp_sendstr_chunk(req,"message}}})();</script>");
